## config/west.yml
```yaml
manifest:
  remotes:
    - name: zmkfirmware
      url-base: https://github.com/zmkfirmware
    # ZMK fork with per-key RGB layer support (darknao's patches on v0.3.0)
    - name: afiqzudinhadi-zmk
      url-base: https://github.com/afiqzudinhadi
    # nice_oled widgets (battery, luna, animations)
    - name: mctechnology17
      url-base: https://github.com/mctechnology17
  projects:
    # Personal fork of ZMK v0.3.0 + modular RGB effect API.
    - name: zmk
      remote: afiqzudinhadi-zmk
      revision: rgb-modular-v1.1
      import: app/west.yml
    # Modular RGB effects module (per-key layer, behaviors, DTS bindings)
    - name: zmk-rgb-effects
      remote: afiqzudinhadi-zmk
      revision: v1.1.1
    # nice_oled widgets (battery, luna, animations)
    - name: zmk-nice-oled
      remote: mctechnology17
      revision: main
  self:
    path: config
```
